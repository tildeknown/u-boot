## board/huawei/agassi2/Kconfig
```kconfig
if TARGET_AGASSI2

config SYS_BOARD
	default "agassi2"

config SYS_VENDOR
	default "huawei"

config SYS_CONFIG_NAME
	default "agassi2"

endif
```

## configs/agassi2_defconfig
```kconfig
CONFIG_ARM=y
CONFIG_COUNTER_FREQUENCY=20000000
CONFIG_TARGET_AGASSI2=y
CONFIG_TEXT_BASE=0x00480000
CONFIG_SYS_MALLOC_LEN=0x801000
CONFIG_NR_DRAM_BANKS=1
CONFIG_ENV_SIZE=0x1000
CONFIG_DEFAULT_DEVICE_TREE="hi6250-agassi2"
CONFIG_OF_LIBFDT_OVERLAY=y
CONFIG_SYS_LOAD_ADDR=0x0e200000
CONFIG_IDENT_STRING="\nAgassi2"
# CONFIG_DISPLAY_CPUINFO is not set
# CONFIG_DISPLAY_BOARDINFO is not set
CONFIG_BOARD_EARLY_INIT_F=y
CONFIG_MISC_INIT_R=y
CONFIG_SYS_PROMPT="U-Boot => "
CONFIG_CMD_MD5SUM=y
CONFIG_CMD_MEMINFO=y
CONFIG_PINCTRL=y
CONFIG_PINCTRL_SINGLE=y
```
