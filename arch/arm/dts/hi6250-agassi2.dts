// SPDX-License-Identifier: GPL-2.0-only
/*
 * Device tree for Huawei Mediapad T5
 *
 * Copyright (C) 2025, Tildeguy (tildeguy@mainlining.org)
 */

/dts-v1/;

// #include "hi6250.dtsi"

/ {
	compatible = "hisilicon,hi6250";
	#address-cells = <2>;
	#size-cells = <2>;
	
	chosen {
		bootargs = "earlycon=tty0 console=tty0";

		#address-cells = <2>;
		#size-cells = <2>;
		ranges;

		stdout-path = "framebuffer0";

		framebuffer0: framebuffer@5d000000 {
			compatible = "simple-framebuffer";
			reg = <0 0x5d000000 0 (1080 * 2160 * 4)>;
			width = <1080>;
			height = <2160>;
			stride = <(1080 * 4)>;
			format = "a8r8g8b8";
			status = "okay";
		};
	};
};
